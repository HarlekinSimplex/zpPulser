## components/zp_pwm/Kconfig.projbuild
```kconfig
menu "zpPulser PWM Configuration"

config PWM00A_GPIO
    int "PWM00A output GPIO number"
	range 0 39
	default 19
	help
		GPIO number (IOxx) for timer 0 'A' output.
		Some GPIOs are used for other purposes (flash connections, etc.) and cannot be used.

config PWM00B_GPIO
    int "PWM00B output GPIO number"
	range 0 39
	default 18
	help
		GPIO number (IOxx) for timer 0 'B' output.
		Some GPIOs are used for other purposes (flash connections, etc.) and cannot be used.

config PWM01A_GPIO
    int "PWM01A output GPIO number"
	range 0 39
	default 17
	help
		GPIO number (IOxx) for timer 1 'A' output.
		Some GPIOs are used for other purposes (flash connections, etc.) and cannot be used.

config PWM01B_GPIO
    int "PWM01B output GPIO number"
	range 0 39
	default 16
	help
		GPIO number (IOxx) for timer 1 'B' output.
		Some GPIOs are used for other purposes (flash connections, etc.) and cannot be used.

config PWM02A_GPIO
    int "PWM02A output GPIO number"
	range 0 39
	default 15
	help
		GPIO number (IOxx) for timer 2 'A' output.
		Some GPIOs are used for other purposes (flash connections, etc.) and cannot be used.

config PWM02B_GPIO
    int "PWM02B output GPIO number"
	range 0 39
	default 14
	help
		GPIO number (IOxx) for timer 2 'B' output.
		Some GPIOs are used for other purposes (flash connections, etc.) and cannot be used.

config PWM_U0_RESOLUTION
    int "Resolution of timer group 0"
	range 468750 120000000
	default 100000000
	help
		Resolution of pwm timer group 0
		Maximum resolution is clk/2 with clk at 240Mhz  
		Minimum resolution is clk/512 with clk at 2400Mz
		Best set to multiples of 2 and used with duty cycles of multiples thise resolution   

config PWM00_RESOLUTION
    int "Resolution of timer 0 in group 0"
	range 468750 120000000
	default 100000000
	help
		Resolution of pwm timer 0 at timer group 0
		Maximum resolution is clk/2 with clk at 240Mhz  
		Minimum resolution is clk/512 with clk at 2400Mz
		Best set to multiples of 2 and used with duty cycles of multiples thise resolution
		Timer resolution should align with its group resolution     

config PWM01_RESOLUTION
    int "Resolution of timer 1 in group 0"
	range 468750 120000000
	default 120000000
	help
		Resolution of pwm timer 0 at timer group 0
		Maximum resolution is clk/2 with clk at 240Mhz  
		Minimum resolution is clk/512 with clk at 2400Mz
		Best set to multiples of 2 and used with duty cycles of multiples thise resolution
		Timer resolution should align with its group resolution     

config PWM02_RESOLUTION
    int "Resolution of timer 2 in group 0"
	range 468750 120000000
	default 120000000
	help
		Resolution of pwm timer 0 at timer group 0
		Maximum resolution is clk/2 with clk at 240Mhz  
		Minimum resolution is clk/512 with clk at 2400Mz
		Best set to multiples of 2 and used with duty cycles of multiples thise resolution
		Timer resolution should align with its group resolution     


config PWM00_FRQ
    int "Frequency of PWM00"
	range 8 120000000
	default 2500
	help
		Frequency of PWM00
		Maximum frequency at maximum resolution is clk/2 with clk at 240Mhz  
		Minimum frequency at minimum resolution is clk/512(8bit prescaler)/65536(16bit timer) with clk at 2400Mz

config PWM00_DUTY_A
    string "Duty cycle of PWM00 comperator A"
    default "12.5"
	help
		Duty cycle of PWM00 comperator A
		Use string representation of float

config PWM00_DUTY_B
    string "Duty cycle of PWM00 comperator B"
    default "12.5"
	help
		Duty cycle of PWM00 comperator B
		Use string representation of float

config PWM00_SYNC_VAL
    string "Sync duty of PWM00"
	default "0"
	help
		Use string representation of float

config PWM00_SYNC_SIG
    int "Synchronisation signal for PWM00"
	range 0 6
	default 0
	help
		0 = PWM0_SELECT_NO_INPUT
		1 = PWM0_SELECT_TIMER0_SYNC
		2 = PWM0_SELECT_TIMER1_SYNC
		3 = PWM0_SELECT_TIMER2_SYNC
		4 = PWM0_SELECT_GPIO_SYNC0
		5 = PWM0_SELECT_GPIO_SYNC1
		6 = PWM0_SELECT_GPIO_SYNC2

config PWM00_SYNC_OUT
    int "Synchronization output for PWM00"
	range 0 3
	default 3
	help
		0 = PWM0_SWSYNC_SOURCE_SYNCIN (the input sync signal will be routed to its sync output path)
		1 = PWM0_SWSYNC_SOURCE_TEZ    (sync signal generated when timer counts to zero)
		2 = PWM0_SWSYNC_SOURCE_TEP    (sync signal generated when timer counts to peak)
		3 = PWM0_SWSYNC_SOURCE_DISABLED

config PWM00_DIR
    int "Timer count direction afer sync signal for PWM00"
	range 0 1
	default 0
	help
		0 = PWM0_UP_COUNTER
		1 = PWM0_DOWN_COUNTER

config PWM00_AUTOSTART
    bool "Autostart PWM00 at boot"
	default n
	help
		If set to 1 PWM00 will be initialized and started during boot


config PWM01_FRQ
    int "Frequency of PWM01"
	range 8 120000000
	default 5000
	help
		Frequency of PWM01
		Maximum frequency at maximum resolution is clk/2 with clk at 240Mhz  
		Minimum frequency at minimum resolution is clk/512(8bit prescaler)/65536(16bit timer) with clk at 2400Mz

config PWM01_DUTY_A
    string "Duty cycle of PWM01 comperator A"
    default "25.0"
	help
		Duty cycle of PWM01 comperator A
		Use string representation of float

config PWM01_DUTY_B
    string "Duty cycle of PWM01 comperator B"
    default "25.0"
	help
		Duty cycle of PWM01 comperator B
		Use string representation of float

config PWM01_SYNC_VAL
    string "Sync duty of PWM01"
	default "25.0"
	help
		Use string representation of float

config PWM01_SYNC_SIG
    int "Synchronisation signal for PWM01"
	range 0 6
	default 0
	help
		0 = PWM0_SELECT_NO_INPUT
		1 = PWM0_SELECT_TIMER0_SYNC
		2 = PWM0_SELECT_TIMER1_SYNC
		3 = PWM0_SELECT_TIMER2_SYNC
		4 = PWM0_SELECT_GPIO_SYNC0
		5 = PWM0_SELECT_GPIO_SYNC1
		6 = PWM0_SELECT_GPIO_SYNC2

config PWM01_SYNC_OUT
    int "Synchronization output for PWM01"
	range 0 3
	default 3
	help
		0 = PWM0_SWSYNC_SOURCE_SYNCIN (the input sync signal will be routed to its sync output path)
		1 = PWM0_SWSYNC_SOURCE_TEZ    (sync signal generated when timer counts to zero)
		2 = PWM0_SWSYNC_SOURCE_TEP    (sync signal generated when timer counts to peak)
		3 = PWM0_SWSYNC_SOURCE_DISABLED

config PWM01_DIR
    int "Timer count direction afer sync signal for PWM01"
	range 0 1
	default 1
	help
		0 = PWM0_UP_COUNTER
		1 = PWM0_DOWN_COUNTER

config PWM01_AUTOSTART
    bool "Autostart PWM01 at boot"
	default n
	help
		If set to 1 PWM01 will be initialized and started during boot


config PWM02_FRQ
    int "Frequency of PWM02"
	range 8 120000000
	default 7500
	help
		Frequency of PWM02
		Maximum frequency at maximum resolution is clk/2 with clk at 240Mhz  
		Minimum frequency at minimum resolution is clk/512(8bit prescaler)/65536(16bit timer) with clk at 2400Mz

config PWM02_DUTY_A
    string "Duty cycle of PWM02 comperator A"
    default "37.5"
	help
		Duty cycle of PWM02 comperator A
		Use string representation of float

config PWM02_DUTY_B
    string "Duty cycle of PWM02 comperator B"
    default "37.5"
	help
		Duty cycle of PWM02 comperator B
		Use string representation of float

config PWM02_SYNC_VAL
    string "Sync duty of PWM02"
	default "37.5"
	help
		Use string representation of float

config PWM02_SYNC_SIG
    int "Synchronisation signal for PWM02"
	range 0 6
	default 0
	help
		0 = PWM0_SELECT_NO_INPUT
		1 = PWM0_SELECT_TIMER0_SYNC
		2 = PWM0_SELECT_TIMER1_SYNC
		3 = PWM0_SELECT_TIMER2_SYNC
		4 = PWM0_SELECT_GPIO_SYNC0
		5 = PWM0_SELECT_GPIO_SYNC1
		6 = PWM0_SELECT_GPIO_SYNC2

config PWM02_SYNC_OUT
    int "Synchronization output for PWM02"
	range 0 3
	default 3
	help
		0 = PWM0_SWSYNC_SOURCE_SYNCIN (the input sync signal will be routed to its sync output path)
		1 = PWM0_SWSYNC_SOURCE_TEZ    (sync signal generated when timer counts to zero)
		2 = PWM0_SWSYNC_SOURCE_TEP    (sync signal generated when timer counts to peak)
		3 = PWM0_SWSYNC_SOURCE_DISABLED

config PWM02_DIR
    int "Timer count direction afer sync signal for PWM02"
	range 0 1
	default 1
	help
		0 = PWM0_UP_COUNTER
		1 = PWM0_DOWN_COUNTER

config PWM02_AUTOSTART
    bool "Autostart PWM02 at boot"
	default n
	help
		If set to 1 PWM02 will be initialized and started during boot





config PWM10A_GPIO
    int "PWM10A output GPIO number"
	range 0 39
	default 19
	help
		GPIO number (IOxx) for timer 0 'A' output.
		Some GPIOs are used for other purposes (flash connections, etc.) and cannot be used.

config PWM10B_GPIO
    int "PWM10B output GPIO number"
	range 0 39
	default 18
	help
		GPIO number (IOxx) for timer 0 'B' output.
		Some GPIOs are used for other purposes (flash connections, etc.) and cannot be used.

config PWM11A_GPIO
    int "PWM11A output GPIO number"
	range 0 39
	default 17
	help
		GPIO number (IOxx) for timer 1 'A' output.
		Some GPIOs are used for other purposes (flash connections, etc.) and cannot be used.

config PWM11B_GPIO
    int "PWM11B output GPIO number"
	range 0 39
	default 16
	help
		GPIO number (IOxx) for timer 1 'B' output.
		Some GPIOs are used for other purposes (flash connections, etc.) and cannot be used.

config PWM12A_GPIO
    int "PWM12A output GPIO number"
	range 0 39
	default 15
	help
		GPIO number (IOxx) for timer 2 'A' output.
		Some GPIOs are used for other purposes (flash connections, etc.) and cannot be used.

config PWM12B_GPIO
    int "PWM12B output GPIO number"
	range 0 39
	default 14
	help
		GPIO number (IOxx) for timer 2 'B' output.
		Some GPIOs are used for other purposes (flash connections, etc.) and cannot be used.

config PWM_U1_RESOLUTION
    int "Resolution of timer group 1"
	range 468750 120000000
	default 100000000
	help
		Resolution of pwm timer group 0
		Maximum resolution is clk/2 with clk at 240Mhz  
		Minimum resolution is clk/512 with clk at 2400Mz
		Best set to multiples of 2 and used with duty cycles of multiples thise resolution   

config PWM10_RESOLUTION
    int "Resolution of timer 0 in group 0"
	range 468750 120000000
	default 100000000
	help
		Resolution of pwm timer 0 at timer group 0
		Maximum resolution is clk/2 with clk at 240Mhz  
		Minimum resolution is clk/512 with clk at 2400Mz
		Best set to multiples of 2 and used with duty cycles of multiples thise resolution
		Timer resolution should align with its group resolution     

config PWM11_RESOLUTION
    int "Resolution of timer 1 in group 0"
	range 468750 120000000
	default 120000000
	help
		Resolution of pwm timer 0 at timer group 0
		Maximum resolution is clk/2 with clk at 240Mhz  
		Minimum resolution is clk/512 with clk at 2400Mz
		Best set to multiples of 2 and used with duty cycles of multiples thise resolution
		Timer resolution should align with its group resolution     

config PWM12_RESOLUTION
    int "Resolution of timer 2 in group 0"
	range 468750 120000000
	default 120000000
	help
		Resolution of pwm timer 0 at timer group 0
		Maximum resolution is clk/2 with clk at 240Mhz  
		Minimum resolution is clk/512 with clk at 2400Mz
		Best set to multiples of 2 and used with duty cycles of multiples thise resolution
		Timer resolution should align with its group resolution     


config PWM10_FRQ
    int "Frequency of PWM10"
	range 8 120000000
	default 2500
	help
		Frequency of PWM10
		Maximum frequency at maximum resolution is clk/2 with clk at 240Mhz  
		Minimum frequency at minimum resolution is clk/512(8bit prescaler)/65536(16bit timer) with clk at 2400Mz

config PWM10_DUTY_A
    string "Duty cycle of PWM10 comperator A"
    default "12.5"
	help
		Duty cycle of PWM10 comperator A
		Use string representation of float

config PWM10_DUTY_B
    string "Duty cycle of PWM10 comperator B"
    default "12.5"
	help
		Duty cycle of PWM10 comperator B
		Use string representation of float

config PWM10_SYNC_VAL
    string "Sync duty of PWM10"
	default "0"
	help
		Use string representation of float

config PWM10_SYNC_SIG
    int "Synchronisation signal for PWM10"
	range 0 6
	default 0
	help
		0 = PWM1_SELECT_NO_INPUT
		1 = PWM1_SELECT_TIMER0_SYNC
		2 = PWM1_SELECT_TIMER1_SYNC
		3 = PWM1_SELECT_TIMER2_SYNC
		4 = PWM1_SELECT_GPIO_SYNC0
		5 = PWM1_SELECT_GPIO_SYNC1
		6 = PWM1_SELECT_GPIO_SYNC2

config PWM10_SYNC_OUT
    int "Synchronization output for PWM10"
	range 0 3
	default 3
	help
		0 = PWM1_SWSYNC_SOURCE_SYNCIN (the input sync signal will be routed to its sync output path)
		1 = PWM1_SWSYNC_SOURCE_TEZ    (sync signal generated when timer counts to zero)
		2 = PWM1_SWSYNC_SOURCE_TEP    (sync signal generated when timer counts to peak)
		3 = PWM1_SWSYNC_SOURCE_DISABLED

config PWM10_DIR
    int "Timer count direction afer sync signal for PWM10"
	range 0 1
	default 0
	help
		0 = PWM1_UP_COUNTER
		1 = PWM1_DOWN_COUNTER

config PWM10_AUTOSTART
    bool "Autostart PWM10 at boot"
	default n
	help
		If set to 1 PWM10 will be initialized and started during boot


config PWM11_FRQ
    int "Frequency of PWM11"
	range 8 120000000
	default 5000
	help
		Frequency of PWM11
		Maximum frequency at maximum resolution is clk/2 with clk at 240Mhz  
		Minimum frequency at minimum resolution is clk/512(8bit prescaler)/65536(16bit timer) with clk at 2400Mz

config PWM11_DUTY_A
    string "Duty cycle of PWM11 comperator A"
    default "25.0"
	help
		Duty cycle of PWM11 comperator A
		Use string representation of float

config PWM11_DUTY_B
    string "Duty cycle of PWM11 comperator B"
    default "25.0"
	help
		Duty cycle of PWM11 comperator B
		Use string representation of float

config PWM11_SYNC_VAL
    string "Sync duty of PWM11"
	default "25.0"
	help
		Use string representation of float

config PWM11_SYNC_SIG
    int "Synchronisation signal for PWM11"
	range 0 6
	default 0
	help
		0 = PWM1_SELECT_NO_INPUT
		1 = PWM1_SELECT_TIMER0_SYNC
		2 = PWM1_SELECT_TIMER1_SYNC
		3 = PWM1_SELECT_TIMER2_SYNC
		4 = PWM1_SELECT_GPIO_SYNC0
		5 = PWM1_SELECT_GPIO_SYNC1
		6 = PWM1_SELECT_GPIO_SYNC2

config PWM11_SYNC_OUT
    int "Synchronization output for PWM11"
	range 0 3
	default 3
	help
		0 = PWM1_SWSYNC_SOURCE_SYNCIN (the input sync signal will be routed to its sync output path)
		1 = PWM1_SWSYNC_SOURCE_TEZ    (sync signal generated when timer counts to zero)
		2 = PWM1_SWSYNC_SOURCE_TEP    (sync signal generated when timer counts to peak)
		3 = PWM1_SWSYNC_SOURCE_DISABLED

config PWM11_DIR
    int "Timer count direction afer sync signal for PWM11"
	range 0 1
	default 1
	help
		0 = PWM1_UP_COUNTER
		1 = PWM1_DOWN_COUNTER

config PWM11_AUTOSTART
    bool "Autostart PWM11 at boot"
	default n
	help
		If set to 1 PWM11 will be initialized and started during boot


config PWM12_FRQ
    int "Frequency of PWM12"
	range 8 120000000
	default 7500
	help
		Frequency of PWM12
		Maximum frequency at maximum resolution is clk/2 with clk at 240Mhz  
		Minimum frequency at minimum resolution is clk/512(8bit prescaler)/65536(16bit timer) with clk at 2400Mz

config PWM12_DUTY_A
    string "Duty cycle of PWM12 comperator A"
    default "37.5"
	help
		Duty cycle of PWM12 comperator A
		Use string representation of float

config PWM12_DUTY_B
    string "Duty cycle of PWM12 comperator B"
    default "37.5"
	help
		Duty cycle of PWM12 comperator B
		Use string representation of float

config PWM12_SYNC_VAL
    string "Sync duty of PWM12"
	default "37.5"
	help
		Use string representation of float

config PWM12_SYNC_SIG
    int "Synchronisation signal for PWM12"
	range 0 6
	default 0
	help
		0 = PWM1_SELECT_NO_INPUT
		1 = PWM1_SELECT_TIMER0_SYNC
		2 = PWM1_SELECT_TIMER1_SYNC
		3 = PWM1_SELECT_TIMER2_SYNC
		4 = PWM1_SELECT_GPIO_SYNC0
		5 = PWM1_SELECT_GPIO_SYNC1
		6 = PWM1_SELECT_GPIO_SYNC2

config PWM12_SYNC_OUT
    int "Synchronization output for PWM12"
	range 0 3
	default 3
	help
		0 = PWM1_SWSYNC_SOURCE_SYNCIN (the input sync signal will be routed to its sync output path)
		1 = PWM1_SWSYNC_SOURCE_TEZ    (sync signal generated when timer counts to zero)
		2 = PWM1_SWSYNC_SOURCE_TEP    (sync signal generated when timer counts to peak)
		3 = PWM1_SWSYNC_SOURCE_DISABLED

config PWM12_DIR
    int "Timer count direction afer sync signal for PWM12"
	range 0 1
	default 1
	help
		0 = PWM1_UP_COUNTER
		1 = PWM1_DOWN_COUNTER

config PWM12_AUTOSTART
    bool "Autostart PWM12 at boot"
	default n
	help
		If set to 1 PWM12 will be initialized and started during boot


endmenu
```
